## CMakeLists.txt
```
cmake_minimum_required(VERSION 3.20.0)
find_package(Zephyr REQUIRED HINTS $ENV{ZEPHYR_BASE})
project(led_toggle_button)

target_sources(app PRIVATE
  src/main.c
  src/led_toggle.c
  src/fw_update.c
)
target_include_directories(app PRIVATE src)
```

## west.yml
```
manifest:
  self:
    path: study_spec_kit_00
  remotes:
    - name: nrf
      url-base: https://github.com/nrfconnect
  projects:
    - name: sdk-nrf
      remote: nrf
      path: nrf
      revision: v3.2.2
      import:
        path-prefix: external
      clone-depth: 1
```

## prj.conf
```kconfig
# ──────────────────────────────────────────────
# [SYNC] ロジック関連設定
# テスト対象コードの動作に影響する設定。
# 変更時は tests/unit/boards/nrf52840dk_nrf52840.conf にも
# 同じ値を反映すること（scripts/check-conf-sync.sh で検証可能）。
# ──────────────────────────────────────────────
CONFIG_GPIO=y
CONFIG_DK_LIBRARY=y
CONFIG_DK_LIBRARY_BUTTON_SCAN_INTERVAL=15
CONFIG_LOG=y
CONFIG_MCUMGR=y

# ──────────────────────────────────────────────
# [NO-SYNC] ハードウェア / ビルドインフラ設定
# 実チップ固有の設定。テストビルド（native_sim / 実機とも）には
# 同期しないこと。MCUboot パーティション変更や UART 競合など、
# テスト FW の起動・結果取得を壊す設定を含む。
# ──────────────────────────────────────────────
CONFIG_USE_SEGGER_RTT=y
CONFIG_LOG_BACKEND_RTT=y
CONFIG_LOG_BACKEND_UART=n
CONFIG_NET_BUF=y
CONFIG_ZCBOR=y
CONFIG_CRC=y
CONFIG_FLASH=y
CONFIG_FLASH_MAP=y
CONFIG_STREAM_FLASH=y
CONFIG_BOOTLOADER_MCUBOOT=y
CONFIG_MCUBOOT_IMGTOOL_SIGN_VERSION="0.0.1+0"
CONFIG_IMG_MANAGER=y
CONFIG_MCUMGR_GRP_IMG=y
CONFIG_MCUMGR_GRP_OS=y
CONFIG_BASE64=y
CONFIG_MCUMGR_TRANSPORT_UART=y
CONFIG_CONSOLE=y

# ──────────────────────────────────────────────
# [NO-SYNC] メモリチューニング
# スタックサイズ等の調整。テストではデフォルト値で十分。
# テスト FW に入れても害はないが、同期管理のコストに見合わない。
# ──────────────────────────────────────────────
CONFIG_SYSTEM_WORKQUEUE_STACK_SIZE=2304
CONFIG_MAIN_STACK_SIZE=2176
```

## src/main.c
```c
/*
 * LED Toggle Button Application for nRF52840DK
 *
 * Toggles LEDs on button press using dk_buttons_and_leds library.
 * Button N toggles LED N (N = 1..4).
 *
 * Functional Requirements: FR-001 through FR-007
 * See specs/001-led-toggle-button/spec.md for full specification.
 *
 * SPDX-License-Identifier: LicenseRef-Nordic-5-Clause
 */

#include <zephyr/kernel.h>
#include <zephyr/dfu/mcuboot.h>
#include <zephyr/sys/reboot.h>
#include <errno.h>
#include <dk_buttons_and_leds.h>
#include <zephyr/logging/log.h>

#include "fw_update.h"
#include "led_toggle.h"

LOG_MODULE_REGISTER(led_toggle, LOG_LEVEL_INF);

static struct k_work_delayable fw_timeout_work;
static struct k_work_delayable fw_led_work;
static uint32_t fw_waiting_start_ms;
static bool fw_led4_level;
static uint32_t fw_failure_toggle_count;

static void apply_leds_from_mode(void)
{
	fw_update_state_t state = fw_update_get_state();
	fw_update_led_cmd_t cmd = { 0 };
	uint32_t mask = led_toggle_get_state();

	if (state == FW_UPDATE_STATE_IDLE) {
		dk_set_leds(mask);
		return;
	}

	fw_update_get_led_cmd(&cmd);
	mask = 0U;

	if (cmd.led1_on) {
		mask |= DK_LED1_MSK;
	}
	if (cmd.led2_on) {
		mask |= DK_LED2_MSK;
	}
	if (cmd.led3_on) {
		mask |= DK_LED3_MSK;
	}
	if (cmd.led4_on) {
		mask |= DK_LED4_MSK;
	}
	if (cmd.led4_blink && fw_led4_level) {
		mask |= DK_LED4_MSK;
	}

	dk_set_leds(mask);
}

static void schedule_led_worker(void)
{
	fw_update_state_t state = fw_update_get_state();

	if (state == FW_UPDATE_STATE_WAITING ||
	    state == FW_UPDATE_STATE_TRANSFERRING ||
	    state == FW_UPDATE_STATE_NOTIFY_FAILURE) {
		(void)k_work_reschedule(&fw_led_work,
			K_MSEC(FW_UPDATE_BLINK_INTERVAL_MS));
	} else {
		(void)k_work_cancel_delayable(&fw_led_work);
	}
}

static void finish_notify_success(void)
{
	(void)fw_update_process_event(FW_UPDATE_EVT_NOTIFY_DONE);
	LOG_INF("Firmware update success notification completed. Rebooting.");
	sys_reboot(SYS_REBOOT_WARM);
}

static void fw_led_work_handler(struct k_work *work)
{
	ARG_UNUSED(work);

	fw_update_state_t state = fw_update_get_state();

	if (state == FW_UPDATE_STATE_WAITING ||
	    state == FW_UPDATE_STATE_TRANSFERRING) {
		fw_led4_level = !fw_led4_level;
		apply_leds_from_mode();
		schedule_led_worker();
		return;
	}

	if (state == FW_UPDATE_STATE_NOTIFY_FAILURE) {
		fw_led4_level = !fw_led4_level;
		fw_failure_toggle_count++;
		apply_leds_from_mode();

		if (fw_failure_toggle_count >= (FW_UPDATE_FAILURE_BLINK_COUNT * 2U)) {
			LOG_WRN("Firmware update failure notification completed. Returning to normal operation.");
			(void)fw_update_process_event(FW_UPDATE_EVT_NOTIFY_DONE);
			fw_failure_toggle_count = 0U;
			fw_led4_level = false;
			apply_leds_from_mode();
			return;
		}

		schedule_led_worker();
		return;
	}

	if (state == FW_UPDATE_STATE_NOTIFY_SUCCESS) {
		finish_notify_success();
	}
}

static void fw_timeout_work_handler(struct k_work *work)
{
	ARG_UNUSED(work);

	fw_update_state_t state = fw_update_get_state();

	if (state != FW_UPDATE_STATE_WAITING) {
		return;
	}

	uint32_t elapsed = k_uptime_get_32() - fw_waiting_start_ms;
	if (fw_update_check_timeout(elapsed)) {
		LOG_WRN("Firmware update waiting timeout: %u ms", elapsed);
		fw_led4_level = false;
		apply_leds_from_mode();
		return;
	}

	(void)k_work_reschedule(&fw_timeout_work, K_MSEC(100));
}

static int fw_update_upload_check(void)
{
	if (fw_update_get_state() != FW_UPDATE_STATE_WAITING) {
		LOG_WRN("Upload rejected because the system is not in firmware update waiting state");
		return -EACCES;
	}

	(void)fw_update_process_event(FW_UPDATE_EVT_TRANSFER_START);
	LOG_INF("Firmware transfer started");
	apply_leds_from_mode();
	return 0;
}

static void fw_update_handle_uart_disconnect(void)
{
	if (fw_update_get_state() != FW_UPDATE_STATE_TRANSFERRING) {
		return;
	}

	(void)fw_update_process_event(FW_UPDATE_EVT_UART_DISCONNECT);
	fw_failure_toggle_count = 0U;
	fw_led4_level = false;
	LOG_ERR("UART disconnect detected. Handling firmware update as failure");
	apply_leds_from_mode();
	schedule_led_worker();
}

static void button_handler(uint32_t button_state, uint32_t has_changed)
{
	uint32_t pressed = has_changed & button_state;
	fw_update_state_t before = fw_update_get_state();

	if (pressed & DK_BTN4_MSK) {
		if (fw_update_is_button_allowed(DK_BTN4_MSK)) {
			fw_update_state_t after =
				fw_update_process_event(FW_UPDATE_EVT_BUTTON4_PRESS);

			if (before == FW_UPDATE_STATE_IDLE &&
			    after == FW_UPDATE_STATE_WAITING) {
				fw_waiting_start_ms = k_uptime_get_32();
				fw_led4_level = false;
				LOG_INF("Entered firmware update waiting mode");
				(void)k_work_reschedule(&fw_timeout_work, K_MSEC(100));
				schedule_led_worker();
			} else if (before == FW_UPDATE_STATE_WAITING &&
				   after == FW_UPDATE_STATE_IDLE) {
				LOG_INF("Firmware update waiting mode canceled");
				(void)k_work_cancel_delayable(&fw_timeout_work);
				(void)k_work_cancel_delayable(&fw_led_work);
				fw_led4_level = false;
			}
		} else {
			LOG_WRN("Button 4 operation is invalid in the current state");
		}
	}

	if (pressed & (DK_BTN1_MSK | DK_BTN2_MSK | DK_BTN3_MSK)) {
		if (fw_update_is_button_allowed(pressed)) {
			uint32_t filtered_state = button_state &
				(DK_BTN1_MSK | DK_BTN2_MSK | DK_BTN3_MSK);
			uint32_t filtered_changed = has_changed &
				(DK_BTN1_MSK | DK_BTN2_MSK | DK_BTN3_MSK);
			uint32_t new_state = led_toggle_process(filtered_state,
						       filtered_changed);

			if (led_toggle_had_press()) {
				LOG_INF("Normal LED operation: state=0x%08x", new_state);
			}
		} else {
			LOG_WRN("Ignoring Buttons 1-3 during firmware update");
		}
	}

	fw_update_state_t state = fw_update_get_state();
	if (state == FW_UPDATE_STATE_NOTIFY_SUCCESS) {
		apply_leds_from_mode();
		(void)k_work_reschedule(&fw_led_work,
			K_MSEC(FW_UPDATE_SUCCESS_DURATION_MS));
	} else {
		apply_leds_from_mode();
		schedule_led_worker();
	}
}

int main(void)
{
	int err;

	LOG_INF("LED Toggle Button application started");
	k_work_init_delayable(&fw_timeout_work, fw_timeout_work_handler);
	k_work_init_delayable(&fw_led_work, fw_led_work_handler);

	fw_update_init();

	if (!boot_is_img_confirmed()) {
		err = boot_write_img_confirmed();
		if (err) {
			LOG_ERR("MCUboot confirm failed: %d", err);
		} else {
			LOG_INF("MCUboot confirm completed");
		}
	}

	/* Initialize LED toggle logic — all OFF (FR-001) */
	led_toggle_reset();

	/* Initialize LEDs hardware — all OFF (FR-001) */
	err = dk_leds_init();
	if (err) {
		LOG_ERR("dk_leds_init failed (err %d)", err);
		return err;
	}

	/* Explicitly set all LEDs off to guarantee initial state (FR-001) */
	dk_set_leds(0);

	/* Initialize buttons with callback (debounce handled by dk_library) */
	err = dk_buttons_init(button_handler);
	if (err) {
		LOG_ERR("dk_buttons_init failed (err %d)", err);
		return err;
	}

	LOG_INF("All LEDs initialized OFF, led_state=0x%08x",
		led_toggle_get_state());
	LOG_INF("Buttons ready. Press Button N to toggle LED N.");
	LOG_INF("Press Button 4 to enter firmware update waiting mode");

	ARG_UNUSED(fw_update_upload_check);
	ARG_UNUSED(fw_update_handle_uart_disconnect);

	return 0;
}
```

## src/fw_update.c
```c
#include "fw_update.h"

#include <dk_buttons_and_leds.h>
#include <zephyr/kernel.h>

static fw_update_state_t current_state = FW_UPDATE_STATE_IDLE;

void fw_update_init(void)
{
	current_state = FW_UPDATE_STATE_IDLE;
}

fw_update_state_t fw_update_get_state(void)
{
	return current_state;
}

fw_update_state_t fw_update_process_event(fw_update_event_t event)
{
	switch (current_state) {
	case FW_UPDATE_STATE_IDLE:
		if (event == FW_UPDATE_EVT_BUTTON4_PRESS) {
			current_state = FW_UPDATE_STATE_WAITING;
		}
		break;
	case FW_UPDATE_STATE_WAITING:
		if (event == FW_UPDATE_EVT_BUTTON4_PRESS ||
		    event == FW_UPDATE_EVT_TIMEOUT) {
			current_state = FW_UPDATE_STATE_IDLE;
		} else if (event == FW_UPDATE_EVT_TRANSFER_START) {
			current_state = FW_UPDATE_STATE_TRANSFERRING;
		}
		break;
	case FW_UPDATE_STATE_TRANSFERRING:
		if (event == FW_UPDATE_EVT_TRANSFER_COMPLETE) {
			current_state = FW_UPDATE_STATE_VERIFYING;
		} else if (event == FW_UPDATE_EVT_UART_DISCONNECT) {
			current_state = FW_UPDATE_STATE_NOTIFY_FAILURE;
		}
		break;
	case FW_UPDATE_STATE_VERIFYING:
		if (event == FW_UPDATE_EVT_VERIFY_SUCCESS) {
			current_state = FW_UPDATE_STATE_NOTIFY_SUCCESS;
		} else if (event == FW_UPDATE_EVT_VERIFY_FAILURE) {
			current_state = FW_UPDATE_STATE_NOTIFY_FAILURE;
		}
		break;
	case FW_UPDATE_STATE_NOTIFY_SUCCESS:
		if (event == FW_UPDATE_EVT_NOTIFY_DONE) {
			current_state = FW_UPDATE_STATE_IDLE;
		}
		break;
	case FW_UPDATE_STATE_NOTIFY_FAILURE:
		if (event == FW_UPDATE_EVT_NOTIFY_DONE) {
			current_state = FW_UPDATE_STATE_IDLE;
		}
		break;
	default:
		break;
	}

	return current_state;
}

void fw_update_get_led_cmd(fw_update_led_cmd_t *cmd)
{
	if (cmd == NULL) {
		return;
	}

	cmd->led1_on = false;
	cmd->led2_on = false;
	cmd->led3_on = false;
	cmd->led4_on = false;
	cmd->led4_blink = false;
	cmd->led4_blink_interval_ms = 0U;

	switch (current_state) {
	case FW_UPDATE_STATE_WAITING:
	case FW_UPDATE_STATE_TRANSFERRING:
		cmd->led4_blink = true;
		cmd->led4_blink_interval_ms = FW_UPDATE_BLINK_INTERVAL_MS;
		break;
	case FW_UPDATE_STATE_NOTIFY_SUCCESS:
		cmd->led4_on = true;
		break;
	case FW_UPDATE_STATE_NOTIFY_FAILURE:
		cmd->led4_blink = true;
		cmd->led4_blink_interval_ms = FW_UPDATE_BLINK_INTERVAL_MS;
		break;
	default:
		break;
	}
}

bool fw_update_is_button_allowed(uint32_t button_mask)
{
	if (current_state == FW_UPDATE_STATE_IDLE) {
		return true;
	}

	if (current_state == FW_UPDATE_STATE_WAITING &&
	    (button_mask & DK_BTN4_MSK) != 0U) {
		return true;
	}

	return false;
}

bool fw_update_check_timeout(uint32_t elapsed_ms)
{
	if (current_state != FW_UPDATE_STATE_WAITING) {
		return false;
	}

	if (elapsed_ms >= FW_UPDATE_TIMEOUT_MS) {
		fw_update_process_event(FW_UPDATE_EVT_TIMEOUT);
		return true;
	}

	return false;
}
```

## src/fw_update.h
```c
#ifndef FW_UPDATE_H_
#define FW_UPDATE_H_

#include <stdbool.h>
#include <stdint.h>

#ifdef __cplusplus
extern "C" {
#endif

typedef enum {
	FW_UPDATE_STATE_IDLE = 0,
	FW_UPDATE_STATE_WAITING,
	FW_UPDATE_STATE_TRANSFERRING,
	FW_UPDATE_STATE_VERIFYING,
	FW_UPDATE_STATE_NOTIFY_SUCCESS,
	FW_UPDATE_STATE_NOTIFY_FAILURE,
} fw_update_state_t;

typedef enum {
	FW_UPDATE_EVT_BUTTON4_PRESS = 0,
	FW_UPDATE_EVT_TRANSFER_START,
	FW_UPDATE_EVT_TRANSFER_COMPLETE,
	FW_UPDATE_EVT_VERIFY_SUCCESS,
	FW_UPDATE_EVT_VERIFY_FAILURE,
	FW_UPDATE_EVT_TIMEOUT,
	FW_UPDATE_EVT_UART_DISCONNECT,
	FW_UPDATE_EVT_NOTIFY_DONE,
} fw_update_event_t;

typedef struct {
	bool led1_on;
	bool led2_on;
	bool led3_on;
	bool led4_on;
	bool led4_blink;
	uint32_t led4_blink_interval_ms;
} fw_update_led_cmd_t;

#define FW_UPDATE_TIMEOUT_MS              30000U
#define FW_UPDATE_BLINK_INTERVAL_MS       100U
#define FW_UPDATE_SUCCESS_DURATION_MS     3000U
#define FW_UPDATE_FAILURE_BLINK_COUNT     5U

void fw_update_init(void);
fw_update_state_t fw_update_get_state(void);
fw_update_state_t fw_update_process_event(fw_update_event_t event);
void fw_update_get_led_cmd(fw_update_led_cmd_t *cmd);
bool fw_update_is_button_allowed(uint32_t button_mask);
bool fw_update_check_timeout(uint32_t elapsed_ms);

#ifdef __cplusplus
}
#endif

#endif /* FW_UPDATE_H_ */
```

## src/led_toggle.c
```c
/*
 * LED Toggle Logic Module - Implementation
 *
 * Pure logic: no direct hardware access. All dk_buttons_and_leds
 * bitmask constants are used, but actual GPIO calls remain in main.c.
 *
 * SPDX-License-Identifier: LicenseRef-Nordic-5-Clause
 */

#include "led_toggle.h"
#include <dk_buttons_and_leds.h>

/* LED state managed as a bitmask (data-model: ビットマスク管理)
 * Bit 0: LED 1, Bit 1: LED 2, Bit 2: LED 3, Bit 3: LED 4
 * Initial value: 0x00 (all LEDs off) per FR-001
 */
static uint32_t led_state;

/* Flag: did the last process() call detect a press? */
static int last_had_press;

/* Button-LED pair mapping for loop-based toggle (FR-002) */
static const uint32_t btn_masks[LED_TOGGLE_NUM_PAIRS] = {
	DK_BTN1_MSK, DK_BTN2_MSK, DK_BTN3_MSK, DK_BTN4_MSK
};
static const uint32_t led_masks[LED_TOGGLE_NUM_PAIRS] = {
	DK_LED1_MSK, DK_LED2_MSK, DK_LED3_MSK, DK_LED4_MSK
};

void led_toggle_reset(void)
{
	led_state = 0;
	last_had_press = 0;
}

uint32_t led_toggle_get_state(void)
{
	return led_state;
}

uint32_t led_toggle_process(uint32_t button_state, uint32_t has_changed)
{
	/* Detect press-edge only: changed AND currently pressed (FR-006, FR-007) */
	uint32_t pressed = has_changed & button_state;

	if (!pressed) {
		last_had_press = 0;
		return led_state;
	}

	last_had_press = 1;

	for (int i = 0; i < LED_TOGGLE_NUM_PAIRS; i++) {
		if (pressed & btn_masks[i]) {
			led_state ^= led_masks[i]; /* FR-003: toggle */
		}
	}

	return led_state;
}

int led_toggle_had_press(void)
{
	return last_had_press;
}
```

## src/led_toggle.h
```c
/*
 * LED Toggle Logic Module
 *
 * Provides testable button-to-LED toggle logic, decoupled from
 * hardware-specific dk_buttons_and_leds calls.
 *
 * Functional Requirements: FR-001 through FR-007
 * See specs/001-led-toggle-button/spec.md for full specification.
 *
 * SPDX-License-Identifier: LicenseRef-Nordic-5-Clause
 */

#ifndef LED_TOGGLE_H_
#define LED_TOGGLE_H_

#include <stdint.h>

/** Number of button-LED pairs on nRF52840DK */
#define LED_TOGGLE_NUM_PAIRS 4

/**
 * @brief Reset LED state to all-off (FR-001).
 *
 * Should be called at initialization to guarantee a known starting state.
 */
void led_toggle_reset(void);

/**
 * @brief Get current LED bitmask state.
 *
 * @return Current led_state bitmask.
 */
uint32_t led_toggle_get_state(void);

/**
 * @brief Process button event and compute new LED state.
 *
 * Detects press-edge (FR-006, FR-007), toggles corresponding LEDs (FR-003),
 * and maintains independent per-pair state (FR-005).
 *
 * @param button_state  Current state of all buttons (bitmask).
 * @param has_changed   Which buttons changed since last callback (bitmask).
 *
 * @return New LED bitmask to apply, or 0 if no press detected (caller
 *         should check with led_toggle_had_press()).
 */
uint32_t led_toggle_process(uint32_t button_state, uint32_t has_changed);

/**
 * @brief Check if the last process() call detected a button press.
 *
 * @return true if at least one button press was detected.
 */
int led_toggle_had_press(void);

#endif /* LED_TOGGLE_H_ */
```
