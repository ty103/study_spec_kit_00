## tests/unit/testcase.yaml
```yaml
tests:
  app.led_toggle_button.unit:
    tags:
      - button
      - led
      - unit_test
      - fw_update
    platform_allow:
      - native_sim
      - nrf52840dk/nrf52840
    integration_platforms:
      - native_sim
```
